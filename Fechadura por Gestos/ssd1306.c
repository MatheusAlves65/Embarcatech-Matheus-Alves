#include "ssd1306.h"
#include <string.h>

// Font data for 5x7 characters
static const uint8_t font[] = {
    0x00, 0x00, 0x00, 0x00, 0x00, // (space)
    0x00, 0x00, 0x5F, 0x00, 0x00, // !
    0x00, 0x07, 0x00, 0x07, 0x00, // "
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    0x02, 0x01, 0x02, 0x04, 0x02  // ~
};

static const uint8_t init_cmds[] = {
    0xAE,          // Display off
    0xD5, 0x80,    // Set display clock divide ratio/oscillator frequency
    0xA8, 0x3F,    // Set multiplex ratio (1 to 64)
    0xD3, 0x00,    // Set display offset
    0x40,          // Set start line address
    0x8D, 0x14,    // Enable charge pump regulator
    0x20, 0x00,    // Set memory addressing mode
    0xA1,          // Set segment re-map (A0/A1)
    0xC8,          // Set COM output scan direction
    0xDA, 0x12,    // Set COM pins hardware configuration
    0x81, 0xCF,    // Set contrast control
    0xD9, 0xF1,    // Set pre-charge period
    0xDB, 0x40,    // Set VCOMH deselect level
    0xA4,          // Entire display ON (resume to RAM content display)
    0xA6,          // Set normal display (A6/A7)
    0xAF           // Display ON
};

static void ssd1306_write_cmd(SSD1306_t *oled, const uint8_t *cmd, size_t cmd_len) {
    uint8_t buf[cmd_len + 1];
    buf[0] = 0x00;  // Control byte: Co = 0, D/C# = 0
    memcpy(buf + 1, cmd, cmd_len);
    i2c_write_blocking(oled->i2c_port, oled->address, buf, cmd_len + 1, false);
}

void ssd1306_init(SSD1306_t *oled, uint8_t width, uint8_t height, uint8_t address, i2c_inst_t *i2c_port) {
    oled->width = width;
    oled->height = height;
    oled->pages = height / 8;
    oled->address = address;
    oled->i2c_port = i2c_port;
    memset(oled->buffer, 0, sizeof(oled->buffer));
    ssd1306_write_cmd(oled, init_cmds, sizeof(init_cmds));
}

void ssd1306_clear(SSD1306_t *oled) {
    memset(oled->buffer, 0, sizeof(oled->buffer));
}

void ssd1306_draw_string(SSD1306_t *oled, uint8_t x, uint8_t y, const char *text, uint8_t size) {
    while (*text) {
        char c = *text++;
        if (c < 32 || c > 126) c = 32;
        for (uint8_t i = 0; i < 5; i++) {
            uint8_t line = font[(c - 32) * 5 + i];
            for (uint8_t j = 0; j < 8; j++) {
                if (line & 1) {
                    for (uint8_t sx = 0; sx < size; sx++) {
                        for (uint8_t sy = 0; sy < size; sy++) {
                            oled->buffer[(x + i * size + sx) + ((y + j * size + sy) / 8) * oled->width] |= (1 << ((y + j * size + sy) % 8));
                        }
                    }
                } else {
                    for (uint8_t sx = 0; sx < size; sx++) {
                        for (uint8_t sy = 0; sy < size; sy++) {
                            oled->buffer[(x + i * size + sx) + ((y + j * size + sy) / 8) * oled->width] &= ~(1 << ((y + j * size + sy) % 8));
                        }
                    }
                }
                line >>= 1;
            }
        }
        x += 6 * size;
    }
}

void ssd1306_show(SSD1306_t *oled) {
    for (uint8_t page = 0; page < oled->pages; page++) {
        uint8_t cmd[] = { 0xB0 + page, 0x00, 0x10 };
        ssd1306_write_cmd(oled, cmd, sizeof(cmd));
        uint8_t *buf = oled->buffer + oled->width * page;
        uint8_t temp_buf[oled->width + 1];
        temp_buf[0] = 0x40;
        memcpy(temp_buf + 1, buf, oled->width);
        i2c_write_blocking(oled->i2c_port, oled->address, temp_buf, sizeof(temp_buf), false);
    }
}